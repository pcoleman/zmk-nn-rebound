## config/west.yml
```yaml
manifest:
  remotes:
    - name: Gorbataras
      url-base: https://github.com/Gorbataras
  projects:
    - name: zmk
      remote: Gorbataras
      revision: default_rebound
      import: app/west.yml
  self:
    path: config
```
